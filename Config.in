## Config.in
```kconfig
menu "RERI platform packages"

source "$BR2_EXTERNAL_RERI_PATH/package/reri-papi/Config.in"
source "$BR2_EXTERNAL_RERI_PATH/package/reri-monitor/Config.in"
source "$BR2_EXTERNAL_RERI_PATH/package/reri-monitor-standard/Config.in"
source "$BR2_EXTERNAL_RERI_PATH/package/reri-performance/Config.in"

endmenu
```

## configs/reri_riscv64_defconfig
```kconfig
BR2_riscv=y
BR2_PACKAGE_HOST_LINUX_HEADERS_CUSTOM_6_18=y
BR2_TOOLCHAIN_BUILDROOT_GLIBC=y
BR2_SYSTEM_DHCP="eth0"
BR2_ROOTFS_OVERLAY="$(BR2_EXTERNAL_RERI_PATH)/board/reri/rootfs-overlay"
BR2_PACKAGE_PYTHON3=y
BR2_PACKAGE_PYTHON3_PYC_ONLY=y
BR2_PACKAGE_PYTHON3_SQLITE=y
BR2_PACKAGE_RERI_MONITOR=y
BR2_PACKAGE_RERI_MONITOR_STANDARD=y
BR2_PACKAGE_RERI_PAPI=y
BR2_PACKAGE_RERI_PERFORMANCE=y
BR2_TARGET_ROOTFS_CPIO=y
BR2_TARGET_ROOTFS_CPIO_GZIP=y
```

## package/reri-monitor-standard/Config.in
```kconfig
config BR2_PACKAGE_RERI_MONITOR_STANDARD
	bool "RERI standard kernel/GHES monitor"
	select BR2_PACKAGE_PYTHON3
	select BR2_PACKAGE_PYTHON3_SQLITE
	help
	  Production-oriented monitor that consumes Linux GHES events from
	  /dev/kmsg and never accesses RERI MMIO directly.
```

## package/reri-monitor/Config.in
```kconfig
config BR2_PACKAGE_RERI_MONITOR
	bool "RERI laboratory monitor"
	select BR2_PACKAGE_PYTHON3
	select BR2_PACKAGE_PYTHON3_SQLITE
	help
	  Laboratory dashboard with RERI MMIO inspection and test injection.
```

## package/reri-papi/Config.in
```kconfig
config BR2_PACKAGE_RERI_PAPI
	bool "PAPI with RISC-V SBI PMU support"
	help
	  PAPI 7.2 with support for the Linux RISC-V SBI perf PMU and the
	  exclude_hv behavior required by the current kernel driver.
```

## package/reri-performance/Config.in
```kconfig
config BR2_PACKAGE_RERI_PERFORMANCE
	bool "RERI performance monitor"
	select BR2_PACKAGE_PYTHON3
	select BR2_PACKAGE_PYTHON3_SQLITE
	select BR2_PACKAGE_RERI_PAPI
	help
	  Dashboard that correlates Linux GHES events with per-hart PAPI
	  cycle, instruction, and IPC samples.
```
